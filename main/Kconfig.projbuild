## main/Kconfig.projbuild
```kconfig
menu "micro-ROS ESP32-P4 Configuration"

    config MICRO_ROS_AGENT_IP
        string "micro-ROS Agent IP"
        default "192.168.1.241"
        help
            IP address of the micro-ROS agent.

    config MICRO_ROS_AGENT_PORT
        int "micro-ROS Agent Port"
        default 8888
        help
            UDP port of the micro-ROS agent.

    config MICRO_ROS_DOMAIN_ID
        int "ROS Domain ID"
        default 30
        help
            ROS 2 domain ID for micro-ROS communication.

    config SERVO_I2C_SDA_PIN
        int "I2C SDA GPIO for PCA9685"
        default 7
        help
            GPIO pin for I2C SDA to PCA9685 servo driver.

    config SERVO_I2C_SCL_PIN
        int "I2C SCL GPIO for PCA9685"
        default 8
        help
            GPIO pin for I2C SCL to PCA9685 servo driver.

    config SERVO_PCA9685_ADDR
        hex "PCA9685 I2C Address"
        default 0x44
        help
            I2C address of the PCA9685 servo driver.

    config ETH_MDC_GPIO
        int "Ethernet MDC GPIO"
        default 31
        help
            GPIO pin for RMII MDC (Management Data Clock).

    config ETH_MDIO_GPIO
        int "Ethernet MDIO GPIO"
        default 52
        help
            GPIO pin for RMII MDIO (Management Data I/O).

    config ETH_PHY_RST_GPIO
        int "Ethernet PHY Reset GPIO"
        default 51
        help
            GPIO pin for PHY reset. Set to -1 if not used.

    config ETH_PHY_ADDR
        int "Ethernet PHY Address"
        default 1
        help
            PHY address on the MDIO bus.

    config WEBSERVER_PORT
        int "Web Dashboard Port"
        default 80
        help
            HTTP port for the status dashboard.

    config WIFI_SSID
        string "WiFi SSID"
        default "DingoNet"
        help
            SSID of the WiFi network to connect to.

    config WIFI_PASSWORD
        string "WiFi Password"
        default "policymeeting"
        help
            Password of the WiFi network.

endmenu
```

## sdkconfig.defaults
```kconfig
# Target: ESP32-P4
CONFIG_IDF_TARGET="esp32p4"

# Flash
CONFIG_ESPTOOLPY_FLASHSIZE_32MB=y
CONFIG_ESPTOOLPY_FLASHSIZE="32MB"
CONFIG_PARTITION_TABLE_SINGLE_APP_LARGE=y

# PSRAM (Hex-PSRAM via LDO channel 2)
CONFIG_SPIRAM=y
CONFIG_SPIRAM_MODE_HEX=y
CONFIG_SPIRAM_SPEED_20M=y
CONFIG_SPIRAM_BOOT_INIT=y
CONFIG_SPIRAM_USE_MALLOC=y
CONFIG_SPIRAM_MALLOC_ALWAYSINTERNAL=16384
CONFIG_SPIRAM_MALLOC_RESERVE_INTERNAL=32768

# Ethernet EMAC + IP101GRI PHY (Waveshare ESP32-P4-WiFi6-PoE-ETH)
CONFIG_ETH_USE_ESP32_EMAC=y
CONFIG_ETH_PHY_INTERFACE_RMII=y
CONFIG_ETH_DMA_BUFFER_SIZE=1600
CONFIG_ETH_DMA_RX_BUFFER_NUM=30
CONFIG_ETH_DMA_TX_BUFFER_NUM=30

# LWIP TCP tuning for high-throughput Ethernet
CONFIG_LWIP_TCP_WND_DEFAULT=65535
CONFIG_LWIP_TCP_SND_BUF_DEFAULT=65535
CONFIG_LWIP_TCP_RECVMBOX_SIZE=64
CONFIG_LWIP_TCPIP_RECVMBOX_SIZE=64
CONFIG_LWIP_TCP_ACCEPTMBOX_SIZE=16
CONFIG_LWIP_UDP_RECVMBOX_SIZE=64
CONFIG_LWIP_MAX_SOCKETS=16

# FreeRTOS
CONFIG_FREERTOS_HZ=1000
CONFIG_FREERTOS_GENERATE_RUN_TIME_STATS=y
CONFIG_FREERTOS_USE_STATS_FORMATTING_FUNCTIONS=y
CONFIG_FREERTOS_VTASKDELAY_VALUE_RANGE=y
CONFIG_FREERTOS_USE_TRACE_FACILITY=y
CONFIG_FREERTOS_TLSP_DELETION_CALLBACKS=y

# Temperature sensor
CONFIG_SOC_TEMP_SENSOR_SUPPORTED=y

# Heap
CONFIG_HEAP_TRACING_OFF=y

# micro-ROS needs this
CONFIG_MICRO_ROS_ESP_XRCE_DDS_MIDDLEWARE=y
CONFIG_MICRO_ROS_ESP_NETIF_WLAN=n

# Increase main task stack
CONFIG_ESP_MAIN_TASK_STACK_SIZE=16384

# Console on UART0, with USB-Serial-JTAG as secondary
CONFIG_ESP_CONSOLE_UART_DEFAULT=y
CONFIG_ESP_CONSOLE_SECONDARY_USB_SERIAL_JTAG=y

# WiFi via ESP32-C6 coprocessor (esp_hosted SDIO)
# TODO: re-enable after C6 slave firmware is flashed
# CONFIG_ESP_HOST_WIFI_ENABLED=y
CONFIG_WIFI_SSID="DingoNet"
CONFIG_WIFI_PASSWORD="policymeeting"

# System
CONFIG_ESP_DEFAULT_CPU_FREQ_MHZ_400=y
CONFIG_ESP_DEFAULT_CPU_FREQ_MHZ=400
```
