#include "ssd1306.h"

#include <string.h>
#include "esp_log.h"

static const char *TAG = "ssd1306";

// SSD1306 commands
#define CMD_SET_CONTRAST     0x81
#define CMD_ENTIRE_DISP_RAM  0xA4
#define CMD_SET_NORM_INV     0xA6
#define CMD_SET_DISP         0xAE
#define CMD_SET_MEM_ADDR     0x20
#define CMD_SET_COL_ADDR     0x21
#define CMD_SET_PAGE_ADDR    0x22
#define CMD_SET_DISP_START   0x40
#define CMD_SET_SEG_REMAP    0xA0
#define CMD_SET_MUX_RATIO    0xA8
#define CMD_SET_COM_OUT_DIR  0xC0
#define CMD_SET_DISP_OFFSET  0xD3
#define CMD_SET_COM_PIN_CFG  0xDA
#define CMD_SET_DISP_CLK_DIV 0xD5
#define CMD_SET_PRECHARGE    0xD9
#define CMD_SET_VCOM_DESEL   0xDB
#define CMD_SET_CHARGE_PUMP  0x8D

static i2c_master_dev_handle_t s_dev = NULL;
static uint8_t s_buf[SSD1306_BUF_SIZE];

// Basic 6x8 ASCII font (printable chars 32-126)
static const uint8_t font_6x8[][5] = {
    {0x00,0x00,0x00,0x00,0x00}, // space
    {0x00,0x00,0x5F,0x00,0x00}, // !
    {0x00,0x07,0x00,0x07,0x00}, // "
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    {0x10,0x08,0x08,0x10,0x08}, // ~
};

static bool write_cmd(uint8_t cmd)
{
    uint8_t buf[2] = {0x80, cmd}; // Co=1, D/C#=0
    return i2c_master_transmit(s_dev, buf, 2, 100) == ESP_OK;
}

static bool write_data(const uint8_t *data, size_t len)
{
    // Send in chunks with 0x40 control byte (Co=0, D/C#=1)
    uint8_t chunk[129]; // 1 control + up to 128 data
    chunk[0] = 0x40;
    size_t sent = 0;
    while (sent < len) {
        size_t n = len - sent;
        if (n > 128) n = 128;
        memcpy(chunk + 1, data + sent, n);
        if (i2c_master_transmit(s_dev, chunk, 1 + n, 200) != ESP_OK) return false;
        sent += n;
    }
    return true;
}

bool ssd1306_init(i2c_master_bus_handle_t bus_handle, uint8_t addr)
{
    esp_err_t probe_err = i2c_master_probe(bus_handle, addr, 200);
    if (probe_err != ESP_OK) {
        ESP_LOGW(TAG, "SSD1306 not found at 0x%02X (%s)", addr, esp_err_to_name(probe_err));
        return false;
    }
    ESP_LOGI(TAG, "SSD1306 found at 0x%02X", addr);

    i2c_device_config_t dev_config = {
        .dev_addr_length = I2C_ADDR_BIT_LEN_7,
        .device_address = addr,
        .scl_speed_hz = 400000, // SSD1306 supports 400 kHz
    };
    esp_err_t err = i2c_master_bus_add_device(bus_handle, &dev_config, &s_dev);
    if (err != ESP_OK) {
        ESP_LOGE(TAG, "I2C device add failed: %s", esp_err_to_name(err));
        return false;
    }

    // Init sequence
    write_cmd(CMD_SET_DISP);             // display off
    write_cmd(CMD_SET_MEM_ADDR); write_cmd(0x00); // horizontal addressing
    write_cmd(CMD_SET_DISP_START | 0x00);
    write_cmd(CMD_SET_SEG_REMAP | 0x01); // column 127 = SEG0
    write_cmd(CMD_SET_MUX_RATIO); write_cmd(63);  // 64 lines
    write_cmd(CMD_SET_COM_OUT_DIR | 0x08); // scan from COM63 to COM0
    write_cmd(CMD_SET_DISP_OFFSET); write_cmd(0x00);
    write_cmd(CMD_SET_COM_PIN_CFG); write_cmd(0x12); // alt COM pins, no remap
    write_cmd(CMD_SET_DISP_CLK_DIV); write_cmd(0x80);
    write_cmd(CMD_SET_PRECHARGE); write_cmd(0xF1);
    write_cmd(CMD_SET_VCOM_DESEL); write_cmd(0x30);
    write_cmd(CMD_SET_CONTRAST); write_cmd(0xFF);
    write_cmd(CMD_ENTIRE_DISP_RAM);      // output follows RAM
    write_cmd(CMD_SET_NORM_INV | 0x00);  // normal (not inverted)
    write_cmd(CMD_SET_CHARGE_PUMP); write_cmd(0x14); // enable charge pump
    write_cmd(CMD_SET_DISP | 0x01);      // display on

    ssd1306_clear();
    ssd1306_show();

    ESP_LOGI(TAG, "SSD1306 OLED initialised (128x64)");
    return true;
}

void ssd1306_clear(void)
{
    memset(s_buf, 0, sizeof(s_buf));
}

void ssd1306_pixel(int x, int y, bool on)
{
    if (x < 0 || x >= SSD1306_WIDTH || y < 0 || y >= SSD1306_HEIGHT) return;
    int idx = x + (y / 8) * SSD1306_WIDTH;
    if (on)
        s_buf[idx] |= (1 << (y & 7));
    else
        s_buf[idx] &= ~(1 << (y & 7));
}

void ssd1306_hline(int x, int y, int w, bool on)
{
    for (int i = 0; i < w; i++) ssd1306_pixel(x + i, y, on);
}

void ssd1306_vline(int x, int y, int h, bool on)
{
    for (int i = 0; i < h; i++) ssd1306_pixel(x, y + i, on);
}

void ssd1306_rect(int x, int y, int w, int h, bool on)
{
    ssd1306_hline(x, y, w, on);
    ssd1306_hline(x, y + h - 1, w, on);
    ssd1306_vline(x, y, h, on);
    ssd1306_vline(x + w - 1, y, h, on);
}

void ssd1306_fill_rect(int x, int y, int w, int h, bool on)
{
    for (int j = 0; j < h; j++)
        ssd1306_hline(x, y + j, w, on);
}

int ssd1306_char(int x, int y, char c)
{
    if (c < 32 || c > 126) c = '?';
    const uint8_t *glyph = font_6x8[c - 32];
    for (int col = 0; col < 5; col++) {
        uint8_t line = glyph[col];
        for (int row = 0; row < 8; row++) {
            ssd1306_pixel(x + col, y + row, (line >> row) & 1);
        }
    }
    // 1 pixel spacing
    for (int row = 0; row < 8; row++)
        ssd1306_pixel(x + 5, y + row, false);
    return 6;
}

int ssd1306_text(int x, int y, const char *str)
{
    while (*str) {
        x += ssd1306_char(x, y, *str++);
    }
    return x;
}

int ssd1306_text_large(int x, int y, const char *str)
{
    while (*str) {
        char c = *str++;
        if (c < 32 || c > 126) c = '?';
        const uint8_t *glyph = font_6x8[c - 32];
        for (int col = 0; col < 5; col++) {
            uint8_t line = glyph[col];
            for (int row = 0; row < 8; row++) {
                bool on = (line >> row) & 1;
                ssd1306_pixel(x + col * 2, y + row * 2, on);
                ssd1306_pixel(x + col * 2 + 1, y + row * 2, on);
                ssd1306_pixel(x + col * 2, y + row * 2 + 1, on);
                ssd1306_pixel(x + col * 2 + 1, y + row * 2 + 1, on);
            }
        }
        // 2 pixel spacing
        for (int row = 0; row < 16; row++) {
            ssd1306_pixel(x + 10, y + row, false);
            ssd1306_pixel(x + 11, y + row, false);
        }
        x += 12;
    }
    return x;
}

bool ssd1306_show(void)
{
    if (s_dev == NULL) return false;
    write_cmd(CMD_SET_COL_ADDR);  write_cmd(0); write_cmd(127);
    write_cmd(CMD_SET_PAGE_ADDR); write_cmd(0); write_cmd(7);
    return write_data(s_buf, SSD1306_BUF_SIZE);
}

void ssd1306_display_on(bool on)
{
    write_cmd(CMD_SET_DISP | (on ? 0x01 : 0x00));
}

void ssd1306_contrast(uint8_t val)
{
    write_cmd(CMD_SET_CONTRAST);
    write_cmd(val);
}

void ssd1306_invert(bool inv)
{
    write_cmd(CMD_SET_NORM_INV | (inv ? 0x01 : 0x00));
}
